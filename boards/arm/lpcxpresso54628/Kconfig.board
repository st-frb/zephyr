## boards/arm/lpcxpresso54628/Kconfig.board
```kconfig
# LPCXpresso54608 board

# Copyright (c) 2017, NXP
# SPDX-License-Identifier: Apache-2.0

config BOARD_LPCXPRESSO54628
	bool "NXP LPCXPRESSO54628"
	depends on SOC_SERIES_LPC54XXX
	select SOC_PART_NUMBER_LPC54628J512ET180
```

## boards/arm/lpcxpresso54628/Kconfig.defconfig
```kconfig
# LPCXpresso54114 board

# Copyright (c) 2017, NXP
# SPDX-License-Identifier: Apache-2.0

if BOARD_LPCXPRESSO54608

config BOARD
	default "lpcxpresso54628" if BOARD_LPCXPRESSO54628

endif # BOARD_LPCXPRESSO54628
```
